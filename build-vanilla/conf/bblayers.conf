## build-vanilla/conf/bblayers.conf
```bitbake
POKY_BBLAYERS_CONF_VERSION = "2"
BBPATH = "${TOPDIR}"
BBFILES ?= ""
BBLAYERS ?= " \
  /var/yocto/symoneural/meta \
  /var/yocto/symoneural/meta-symoneural \
  /var/yocto/symoneural/meta-openembedded/meta-oe \
  /var/yocto/symoneural/meta-openembedded/meta-python \
  /var/yocto/symoneural/meta-openembedded/meta-networking \
  /var/yocto/symoneural/meta-clang \
  "
```

## meta-neural/conf/layer.conf
```bitbake
BBPATH .= ":${LAYERDIR}"
BBFILES += "${LAYERDIR}/recipes-*/*/*.bb \
            ${LAYERDIR}/recipes-*/*/*.bbappend"

BBFILE_COLLECTIONS += "neural"
BBFILE_PATTERN_neural = "^${LAYERDIR}/"
BBFILE_PRIORITY_neural = "6"
LAYERSERIES_COMPAT_neural = "scarthgap"
```

## meta-symon/conf/distro/symonos.conf
```bitbake
DISTRO = "symonos"
DISTRO_NAME = "SyMoNeuRaL OS"
DISTRO_VERSION = "1.0"
DISTRO_CODENAME = "symoneural-core"
SDK_VENDOR = "-symoneuralsdk"
MAINTAINER = "Garrett McDonald <your-email@symoneural.com>"

# --- Architecture & Packaging ---
TARGET_VENDOR = "-symoneural"

PACKAGE_CLASSES ?= "package_ipk"

# --- Init System (Systemd Focus) ---
DISTRO_FEATURES:append = " systemd"
VIRTUAL-RUNTIME_init_manager = "systemd"
DISTRO_FEATURES_BACKFILL_CONSIDERED = "sysvinit"
VIRTUAL-RUNTIME_initscripts = ''

# --- Distro Features ---
# Cleaned up the duplicates and added standard essentials

# --- SDK Policy ---
SDK_NAME = "${DISTRO}-${SDKMACHINE}-${IMAGE_BASENAME}-${MACHINE}"
SDKPATH = "/opt/${DISTRO}/${DISTRO_VERSION}"

# --- Image Policy ---
IMAGE_FSTYPES += "tar.zst ext4 wic"

# --- Quality Assurance & Security ---
ERROR_QA = "version-going-backwards"
require conf/distro/include/security_flags.inc
require conf/distro/include/yocto-uninative.inc
require conf/distro/include/no-static-libs.inc
INHERIT += "uninative symoneural-sanity"
```

## meta-symoneural-bsp/conf/layer.conf
```bitbake
BBPATH .= ":${LAYERDIR}"
BBFILES += "${LAYERDIR}/recipes-*/*/*.bb \
            ${LAYERDIR}/recipes-*/*/*.bbappend"

BBFILE_COLLECTIONS += "symoneural-bsp"
BBFILE_PATTERN_symoneural-bsp = "^${LAYERDIR}/"
BBFILE_PRIORITY_symoneural-bsp = "6"

LAYERDEPENDS_symoneural-bsp = "core symoneural"
LAYERSERIES_COMPAT_symoneural-bsp = "scarthgap"
```

## meta-symoneural-bsp/conf/machine/nvidia-rtx50-series.conf
```bitbake
# MODEL: NVIDIA RTX 50-Series Workstation
# TARGET: Generic x86-64 with Bleeding Edge Drivers

MACHINE = "generic-x86-64"
PREFERRED_PROVIDER_virtual/kernel = "linux-yocto"
MACHINE_ESSENTIAL_EXTRA_RRECOMMENDS += "kernel-module-nvidia nvidia-utils"
PREFERRED_VERSION_nvidia-open-kernel-modules = "590.%"
LICENSE_FLAGS_ACCEPTED += "commercial_nvidia"
```

## meta-symoneural/conf/distro/include/symoneural-floating-revisions.inc
```bitbake
#Auto Rev Recipes

INHERIT += "symoneural-bleeding"

SYMONEURAL_AUTOREV_RECIPES = "\
libmatchbox \
opkg-utils \
matchbox-config-gtk \
matchbox-desktop \
matchbox-keyboard \
matchbox-panel-2 \
matchbox-terminal \
matchbox-theme-sato \
matchbox-wm \
pseudo \
puzzles \
sato-icon-theme \
sato-screenshot \
settings-daemon \
"
```

## meta-symoneural/conf/distro/symon-altcfg.conf
```bitbake
require conf/distro/symonos.conf

DISTRO = "symon-altcfg"
DISTRO_NAME = "SymonOS Alternate (Dev/Test)"

DISTROOVERRIDES = "symonos:symon-altcfg"
#DISTROOVERRIDES = "symonos:linuxstdbase"

SYMONEURAL_INIT_MANAGER:symon-altcfg = "sysvinit"
SYMONEURAL_DISTRO_FEATURES:remove = "systemd"

require conf/distro/include/symoneural-dev-upgrade.inc
```

## meta-symoneural/conf/distro/symon-tiny.conf
```bitbake
require conf/distro/include/gcsections.inc

DISTRO = "symon-tiny"
DISTRO_NAME = "SymonOS Tiny"
DISTRO_VERSION = "1.0"
DISTRO_CODENAME = "genesis"

MAINTAINER = "Symoneural Maintainer <garrett@symoneural.com>"
TARGET_VENDOR = "-symoneural"
SDK_VENDOR = "-symoneuralsdk"

TCLIBC = "musl"
FULL_OPTIMIZATION = "-Os -pipe ${DEBUG_FLAGS}"

PREFERRED_PROVIDER_virtual/kernel = "linux-yocto-tiny"
PREFERRED_VERSION_linux-yocto-tiny ?= "6.12%"

DISTRO_FEATURES = "pci ipv4 ipv6 usbhost largefile"

DISTRO_FEATURES:class-native = "pci ipv4 ipv6 usbhost largefile x11 opengl wayland"
DISTRO_FEATURES:class-nativesdk = "pci ipv4 ipv6 usbhost largefile x11 opengl wayland"

INIT_MANAGER = "mdev-busybox"
VIRTUAL-RUNTIME_dev_manager = "busybox-mdev"
VIRTUAL-RUNTIME_init_manager = "busybox"
VIRTUAL-RUNTIME_initscripts = "initscripts"

ENABLE_WIDEC = "false"
ENABLE_WIDEC:class-native = "true"
USE_NLS = "no"
IMAGE_LINGUAS = ""

SYMONEURAL_DEFAULT_EXTRA_RRECOMMENDS = ""
MACHINE_ESSENTIAL_EXTRA_RDEPENDS = ""

IMAGE_FSTYPES = "cpio.gz wic"
QB_DEFAULT_FSTYPE = "cpio.gz"

SKIP_RECIPE[core-image-sato] = "not buildable with symon-tiny"
SKIP_RECIPE[core-image-weston] = "not buildable with symon-tiny"
SKIP_RECIPE[core-image-x11] = "not buildable with symon-tiny"

PACKAGECONFIG:remove:pn-opkg-utils = "python"
PACKAGE_EXCLUDE += "shadow-base"

LOCALCONF_VERSION = "2"
LAYER_CONF_VERSION ?= "8"
```

## meta-symoneural/conf/distro/symoneural.conf
```bitbake
DISTRO = "symoneural"
DISTRO_NAME = "SyMoNeuRaL OS"
DISTRO_VERSION = "1.0"
DISTRO_CODENAME = "scarthgap"
SDK_VENDOR = "-symosdk"
SDK_VERSION = "${DISTRO_VERSION}"

MAINTAINER = "Garrett Parker Mcdonald"

TARGET_VENDOR = "-symo"

LOCALCONF_VERSION = "2"

DISTRO_FEATURES:append = " virtualization systemd opengl"
DISTRO_FEATURES_BACKFILL_CONSIDERED += "sysvinit"
VIRTUAL-RUNTIME_init_manager = "systemd"
VIRTUAL-RUNTIME_initscripts = "systemd-compat-units"
```

## meta-symoneural/conf/distro/symonos.conf
```bitbake
DISTRO = "symonos"
DISTRO_NAME = "SymonOS Linux"
DISTRO_VERSION = "1.0"
DISTRO_CODENAME = "whinlatter"
SDK_VENDOR = "-symoneuralsdk"
SDK_VERSION[vardepvalue] = "${SDK_VERSION}"

MAINTAINER = "Symoneural Maintainer Garrett McDonald"
TARGET_VENDOR = "-symoneural"
LOCALCONF_VERSION = "2"

SYMONEURAL_DEFAULT_DISTRO_FEATURES = "ssh-server-dropbear"
SYMONEURAL_EXTRA_RDEPENDS = "packagegroup-core-boot"
SYMONEURAL_EXTRA_RRECOMMENDS = "kernel-module-af-packet"

DISTRO_EXTRA_RDEPENDS += "${SYMONEURAL_EXTRA_RDEPENDS}"
DISTRO_EXTRA_RRECOMMENDS += "${SYMONEURAL_EXTRA_RRECOMMENDS}"

SYMONEURAL_INIT_MANAGER = "systemd"
INIT_MANAGER ?= "${SYMONEURAL_INIT_MANAGER}"

VIRTUAL-RUNTIME_init_manager = "systemd"
VIRTUAL-RUNTIME_initscripts = "systemd-compat-units"
DISTRO_FEATURES_BACKFILL_CONSIDERED += "sysvinit"

DISTRO_FEATURES ?= "${DISTRO_FEATURES_DEFAULT} \
                    ${SYMONEURAL_DEFAULT_DISTRO_FEATURES} \
                    argp largefile usbhost wifi xattr nfs \
                    pci x11 opengl wayland vulkan pulseaudio \
                    multiarch pam systemd usrmerge"

PREFERRED_VERSION_linux-yocto ?= "6.6%"
PREFERRED_VERSION_linux-yocto-rt ?= "6.6%"

PACKAGE_CLASSES ?= "package_ipk package-deb package-rpm"

SDK_NAME = "${DISTRO}-${TCLIBC}-${SDKMACHINE}-${IMAGE_BASENAME}-${TUNE_PKGARCH}-${MACHINE}"
SDKPATH = "/opt/${DISTRO}/${DISTRO_VERSION}"
SDKPATHINSTALL = "/opt/${DISTRO}/${SDK_VERSION}"

IMAGE_FSTYPES += "tar.zst ext4 wic"

ERROR_QA = "version-going-backwards"
require conf/distro/include/security_flags.inc
require conf/distro/include/yocto-uninative.inc
require conf/distro/include/no-static-libs.inc
INHERIT += "uninative"

require conf/distro/include/symoneural-world-exclude.inc

INHERIT += "symoneural-sanity"


# Kernel Policy: High-Performance Desktop
PREFERRED_PROVIDER_virtual/kernel = "linux-yocto"
PREFERRED_VERSION_linux-yocto = "6.6%"
```
