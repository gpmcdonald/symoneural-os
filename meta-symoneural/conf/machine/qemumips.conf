## meta-symoneural/conf/machine/rpi4-64.conf
```bitbake
# MODEL: Raspberry Pi 4 (64-bit)
# TARGET: ARM Cortex-A72

MACHINE = "raspberrypi4-64"
RPI_USE_U_BOOT = "1"
ENABLE_UART = "1"
```

## oe-core-ref-build/conf/bblayers.conf
```bitbake
LCONF_VERSION = "7"
BBPATH = "${TOPDIR}"
BBFILES ?= ""

BBLAYERS ?= " \
  /var/yocto/symoneural/openembedded-core/meta \
  /var/yocto/symoneural/meta-poky \
  /var/yocto/symoneural/meta-symoneural \
  /var/yocto/symoneural/meta-symoneural-bsp \
  "
```

## sources/meta-symon/conf/distro/symon-bleeding.conf
```bitbake
require conf/distro/symonos.conf

DISTRO = "symon-bleeding"
DISTRO_NAME = "SyMoNeuRaL Bleeding Edge (Experimental)"

# Vendor-specific GPU enablement
require conf/distro/include/gpu-support-nvidia.inc

# Overwrite Kernel for Bleeding Edge
# Note: Ensure your layers have 6.12 recipes available
PREFERRED_VERSION_linux-yocto = "6.12%"
PREFERRED_VERSION_linux-yocto-rt = "6.12%"
```

## sources/meta-symon/conf/layer.conf
```bitbake
BBPATH .= ":${LAYERDIR}"
BBFILES += "${LAYERDIR}/recipes-*/*/*.bb \
            ${LAYERDIR}/recipes-*/*/*.bbappend"

BBFILE_COLLECTIONS += "symon"
BBFILE_PATTERN_symon = "^${LAYERDIR}/"
BBFILE_PRIORITY_symon = "7"
LAYERSERIES_COMPAT_symon = "scarthgap"
```

## symoneural-build/conf/bblayers.conf
```bitbake
LCONF_VERSION = "7"
BBPATH = "${TOPDIR}"
BBFILES ?= ""

BBLAYERS ?= " \
  /var/yocto/symoneural/meta-symoneural/meta \
  /var/yocto/symoneural/meta-symoneural \
  /var/yocto/symoneural/meta-openembedded/meta-oe \
  "
```

## symoneural-build/conf/local.conf
```bitbake
DISTRO ?= "symoneural"
MACHINE ?= "qemux86-64"
PACKAGE_CLASSES ?= "package_rpm"
USER_CLASSES ?= "buildstats"
PATCHRESOLVE = "noop"
CONF_VERSION = "2"
```
